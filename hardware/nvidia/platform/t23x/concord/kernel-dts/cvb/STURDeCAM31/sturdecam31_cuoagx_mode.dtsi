				mode0 {/*mode ISX031_MODE_1920X1536_CROP_30FPS*/
					mclk_khz = "24000";
					num_lanes = CAM_LANES_STRING;
					tegra_sinterface = TEGRA_SINTERFACE;
					discontinuous_clk = "no";
					dpcm_enable = "false";
					cil_settletime = "0";
					dynamic_pixel_bit_depth = "16";
					csi_pixel_bit_depth = "16";
					phy_mode = "DPHY";
					mode_type = "yuv";
					pixel_phase = "uyvy";
					vc-id = LOCAL_VC_ID;
					active_w = "1920";
					active_h = "1536";
					readout_orientation = "0";
					line_length = "2800";
					inherent_gain = "1";
					pix_clk_hz = "115500000";
					serdes_pix_clk_hz = "162500000";
					mclk_multiplier = "4";
					gain_factor = "10";
					min_gain_val = "0"; /* dB */
					max_gain_val = "300"; /* dB */
					step_gain_val = "3"; /* 0.3 */
					default_gain = "0";
					min_hdr_ratio = "1";
					max_hdr_ratio = "1";
					framerate_factor = "1000000";
					min_framerate = "30000000";
					max_framerate = "30000000";
					step_framerate = "1";
					default_framerate = "30000000";
					exposure_factor = "1000000";
					min_exp_time = "118";
					max_exp_time = "33333";
					step_exp_time = "1";
					default_exp_time = "33333";/* us */
					embedded_metadata_height = "0";
				};

