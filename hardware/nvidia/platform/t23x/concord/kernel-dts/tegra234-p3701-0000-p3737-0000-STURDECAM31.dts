/*
 * Copyright (c) 2023, e-con Systems.  All rights reserved.
 *
 * This program is free software; you can redistribute it and/or modify it
 * under the terms and conditions of the GNU General Public License,
 * version 2, as published by the Free Software Foundation.
 *
 * This program is distributed in the hope it will be useful, but WITHOUT
 * ANY WARRANTY; without even the implied warranty of MERCHANTABILITY or
 * FITNESS FOR A PARTICULAR PURPOSE.  See the GNU General Public License for
 * more details.
 *
 * You should have received a copy of the GNU General Public License
 * along with this program.  If not, see <http://www.gnu.org/licenses/>.
 */

#include "tegra234-p3701-0000-p3737-0000.dts"
#include "cvb/STURDeCAM31/tegra234-orin-agx-camera-ECON-STURDECAM31.dtsi"

/{
    nvidia,dtsfilename = __FILE__;
    nvidia,dtbbuildtime = __DATE__, __TIME__;
};

